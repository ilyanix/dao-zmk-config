## config/west.yml
```yaml
manifest:
  remotes:
    - name: zmkfirmware
      url-base: https://github.com/zmkfirmware
    - name: ftc
      url-base: https://github.com/ftc/
    - name: pete
      url-base: https://github.com/petejohanson
  projects:
    - name: zmk
      remote: pete
      revision: feat/pointers-move-scroll
      import: app/west.yml
  self:
    path: config
```
